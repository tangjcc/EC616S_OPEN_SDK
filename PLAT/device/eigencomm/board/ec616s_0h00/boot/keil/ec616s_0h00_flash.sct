#! armcc -E
#include "mem_map.h"

LR_IROM1 APP_FLASH_LOAD_ADDR APP_FLASH_LOAD_SIZE  {    ; load region size_region
  UNLOAD_IROM APP_FLASH_LOAD_ADDR APP_FLASH_LOAD_SIZE  {  ; load address = execution address
   *.o (RESET, +First)
   *(.phyCodeFlash_COMN)
   *(.phyCodeFlash_ICS)
   *(.phyCodeFlash_UL)
   *(.phyCodeFlash_RXDFE)
   *(.phyCodeFlash_CE)
   *(.phyCodeFlash_DE)
   *(.phyCodeFlash_AXC)
   *(.phyCodeFlash_RF)
   *(.phyCodeFlash_SCHD)
   *(.phyCodeFlash_MACSF)
   *(.phyCodeFlash_MEAS)
   *(.phyCodeFlash_PMU)
   *(.phyCodeFlash_OTDOA)
   .(.phyCodeFlash_SQ)
   *(.phyDataFlash)
   .ANY (+RO)
  }
  UNLOAD_NOCACHE +0 ALIGN 128{
  cache*.o (+RO)
  }
  LOAD_IRAM1 0x00004000  {  ; code in ram
  *(.ramVector,+First)
  *(.phyCodeSram)
  *(.ramCode)
;   memmove.o (+RO)
  }
  LOAD_IRAM2 +0  {  ; code in ram
  *(.phyCodeSram2)
  *(.ramCode2)
  }
  ScatterAssert(ImageLimit(LOAD_IRAM2) <= 0x0000C800)

  LOAD_DRAM_SHARED 0x0000C800 0x030000  {  ; RW data
  *(.RTTmem)
  *(.phyDataZI)
  .ANY (+RW +ZI)
  }
  ScatterAssert(ImageLimit(LOAD_DRAM_SHARED) < HEAP_MEM_MAX_START_ADDR)
   
  LOAD_DRAM_BSP 0x040800 {   ; RW and ZI used only when wake up from hibernate
  bsp_spi.o(+RW +ZI)
;  cache_ec616s.o(+RW +ZI)
  flash_ec616s.o(+RW +ZI)
  flash_ec616s_rt.o(+RW +ZI)
;  qspi_ec616s.o(+RW +ZI)
;  gpio_ec616s.o(+RW +ZI)
  gpr_ec616s.o(+RW +ZI)
  ecpm_ec616s.o(+RW +ZI)
  bsp.o(+RW +ZI)
  plat_config.o(+RW +ZI)
  system_ec616s.o(+RW +ZI)
  unilog_ec616s.o(+RW +ZI)
  pad_ec616s.o(+RW +ZI)
  ic_ec616s.o(+RW +ZI)
  ec_main.o(+RW +ZI)
  hibtimer_ec616s.o(+RW +ZI)
  slpman_ec616s.o(+RW +ZI)
  bsp_usart.o(+RW +ZI)
  bsp_lpusart.o(+RW +ZI)
  pmu_ec616s.o(+RW +ZI)
  timer_ec616s.o(+RW +ZI)
  dma_ec616s.o(+RW +ZI)
  adc_ec616s.o(+RW +ZI)  
  wdt_ec616s.o(+RW +ZI)
  os_exception.o(+RW +ZI)
  uart_ec616s.o(+RW +ZI)
  batmonraw_ec616s.o(+RW +ZI)
  }

  UNLOAD_DRAM_FLASHMEM 0x00042000 0x1C00 { ; psphyFlashMem
  *(.flashbackupdata)
  }
  UNLOAD_DRAM_SLPMEM 0x00043C00  {  ; Sleep Info
  *(.sleepmem,+FIRST)
  *(.ctTimermem)
  *(.swcnt)
  }
  ScatterAssert(ImageLimit(UNLOAD_DRAM_SLPMEM) < EC_RESET_REASON_ADDR)

  LOAD_IRAM_MCUVECTOR 0x00000000 0x64			{  ; Mcu Vector
  *(.mcuVector)
  }
	
  LOAD_IRAM_MCU 0x64							{  ; for simulation, 16K memory retention in sleep
  *(.ramBootCode)
  *(.mcuCode)
  flash_ec616s.o (+RO)
  qspi_ec616s.o (+RO)
  }
  
  UNLOAD_DRAM_USRNV +0 ALIGN 0x20 {
  *(.usrNvMem)
  }
  LOAD_DRAM_MCU +0 {
  *(.ramBootRWData)
  *(.ramBootZIData)
  } 
  
  UNLOAD_DRAM_PSPHYRET 0x00002800 0x001800  {  ; RW data
  *(.psphyret_6k)
  }
}
